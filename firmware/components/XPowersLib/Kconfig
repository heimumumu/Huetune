## firmware/components/XPowersLib/Kconfig
```kconfig
menu "XPowersLib"
    config XPOWERS_ESP_IDF_NEW_API
        bool "Use ESP-IDF I2C master driver"
        default y
endmenu
```

## firmware/sdkconfig.defaults
```kconfig
CONFIG_IDF_TARGET="esp32s3"
CONFIG_ESPTOOLPY_FLASHSIZE_16MB=y
CONFIG_PARTITION_TABLE_CUSTOM=y
CONFIG_PARTITION_TABLE_CUSTOM_FILENAME="partitions.csv"
CONFIG_SPIRAM=y
CONFIG_SPIRAM_MODE_OCT=y
CONFIG_SPIRAM_SPEED_80M=y
CONFIG_SPIRAM_USE_MALLOC=y
CONFIG_ESP_DEFAULT_CPU_FREQ_MHZ_240=y
CONFIG_ESP_CONSOLE_UART_DEFAULT=y
CONFIG_ESP_CONSOLE_SECONDARY_NONE=y
CONFIG_TINYUSB_CDC_ENABLED=y
CONFIG_TINYUSB_HID_COUNT=1
CONFIG_TINYUSB_CDC_RX_BUFSIZE=8192
CONFIG_TINYUSB_CDC_TX_BUFSIZE=2048
CONFIG_LV_USE_CLIB_MALLOC=y
CONFIG_XPOWERS_ESP_IDF_NEW_API=y
CONFIG_LV_COLOR_DEPTH_16=y
CONFIG_LV_USE_IMAGE=y
CONFIG_LV_USE_SNAPSHOT=y
CONFIG_LV_USE_LABEL=y
CONFIG_LV_USE_BAR=y
CONFIG_LV_USE_SLIDER=y
CONFIG_LV_USE_BUTTONMATRIX=y
CONFIG_COMPILER_CXX_EXCEPTIONS=y
CONFIG_COMPILER_OPTIMIZATION_PERF=y
CONFIG_LV_ATTRIBUTE_FAST_MEM_USE_IRAM=y
CONFIG_FREERTOS_HZ=1000
CONFIG_ESP_MAIN_TASK_STACK_SIZE=16384
```
